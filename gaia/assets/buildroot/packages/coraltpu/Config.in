## gaia/assets/buildroot/packages/coraltpu/Config.in
```kconfig
config BR2_PACKAGE_CORALTPU
    bool "coral-tpu"
    help
      Custom Coral TPU support.
```

## gaia/assets/buildroot/packages/java-runtime/Config.in
```kconfig
config BR2_PACKAGE_JAVA_RUNTIME
	bool "java-runtime"
	depends on BR2_aarch64
	help
	  Install a prebuilt Java runtime for PhotonVision.

	  The package can either download a release archive URL or
	  consume a local archive path.

if BR2_PACKAGE_JAVA_RUNTIME

choice
	prompt "Java runtime source"
	default BR2_PACKAGE_JAVA_RUNTIME_SOURCE_RELEASE

config BR2_PACKAGE_JAVA_RUNTIME_SOURCE_RELEASE
	bool "Download release archive"

config BR2_PACKAGE_JAVA_RUNTIME_SOURCE_LOCAL
	bool "Use local archive path"

endchoice

config BR2_PACKAGE_JAVA_RUNTIME_RELEASE_URL
	string "Release archive URL"
	default "https://github.com/adoptium/temurin21-binaries/releases/download/jdk-21.0.4%2B7/OpenJDK21U-jre_aarch64_linux_hotspot_21.0.4_7.tar.gz"
	depends on BR2_PACKAGE_JAVA_RUNTIME_SOURCE_RELEASE
	help
	  Full URL to the Java runtime tar archive.

config BR2_PACKAGE_JAVA_RUNTIME_LOCAL_PATH
	string "Local archive path"
	default ""
	depends on BR2_PACKAGE_JAVA_RUNTIME_SOURCE_LOCAL
	help
	  Absolute path to a local Java runtime tar archive.

config BR2_PACKAGE_JAVA_RUNTIME_INSTALL_DIR
	string "Install directory"
	default "/usr/lib/jvm"
	help
	  Target path where the runtime should be installed.

endif
```

## gaia/assets/buildroot/packages/libpisp/Config.in
```kconfig
config BR2_PACKAGE_LIBPISP
	bool "libpisp"
	depends on BR2_INSTALL_LIBSTDCPP
	depends on BR2_TOOLCHAIN_HAS_THREADS
	depends on BR2_TOOLCHAIN_GCC_AT_LEAST_9
	select BR2_PACKAGE_BOOST
	select BR2_PACKAGE_JSON_FOR_MODERN_CPP
	help
	  Raspberry Pi PiSP helper library (backend/frontend configuration and
	  tiling utilities) used by the libcamera rpi/pisp pipeline.

comment "libpisp needs a toolchain w/ C++, threads, gcc >= 9"
	depends on !BR2_INSTALL_LIBSTDCPP || !BR2_TOOLCHAIN_HAS_THREADS || \
		!BR2_TOOLCHAIN_GCC_AT_LEAST_9
```

## gaia/assets/buildroot/packages/openvscode-server/Config.in
```kconfig
config BR2_PACKAGE_OPENVSCODE_SERVER
	bool "openvscode-server"
	depends on BR2_aarch64
	depends on BR2_TOOLCHAIN_USES_GLIBC
	help
	  OpenVSCode Server provides a browser-based VS Code experience.
	  This package installs the prebuilt server under /opt/helios/ide
	  for authoring Helios custom nodes on-device.
```

## gaia/assets/buildroot/packages/turbojpeg/Config.in
```kconfig
config BR2_PACKAGE_TURBOJPEG
    bool "libjpeg-turbo"
    help
      Custom TurboJPEG build.
```

## helios/raze/assets/buildroot/packages/libcamera/Config.in
```kconfig
config BR2_PACKAGE_LIBCAMERA_ARCH_SUPPORTS
	bool
	default y
	# Invalid packing size of ControlValue struct on m68k
	depends on !BR2_m68k

menuconfig BR2_PACKAGE_LIBCAMERA
	bool "libcamera"
	depends on BR2_PACKAGE_LIBCAMERA_ARCH_SUPPORTS
	depends on BR2_INSTALL_LIBSTDCPP
	depends on BR2_TOOLCHAIN_HAS_THREADS
	depends on BR2_TOOLCHAIN_GCC_AT_LEAST_9
	depends on !BR2_STATIC_LIBS
	select BR2_PACKAGE_OPENSSL if !BR2_PACKAGE_GNUTLS # IPA signatures
	select BR2_PACKAGE_LIBYAML
	select BR2_PACKAGE_LIBCAMERA_PIPELINE_UVCVIDEO if !BR2_PACKAGE_LIBCAMERA_HAS_PIPELINE
	help
	  libcamera provides a software stack to support
	  complex devices that need heavy hardware image
	  processing operations.

	  http://www.libcamera.org/

if BR2_PACKAGE_LIBCAMERA

config BR2_PACKAGE_LIBCAMERA_PYTHON
	bool "python bindings"
	depends on BR2_PACKAGE_PYTHON3
	select BR2_PACKAGE_PYTHON_PYBIND
	help
	  Enable libcamera python bindings

config BR2_PACKAGE_LIBCAMERA_V4L2
	bool "libcamera v4l2 compatibility layer"
	help
	  libcamera v4l2 compatibility layer

config BR2_PACKAGE_LIBCAMERA_HAS_PIPELINE
	bool

config BR2_PACKAGE_LIBCAMERA_PIPELINE_IMX8_ISI
	bool "imx8-isi pipeline"
	depends on BR2_arm || BR2_aarch64
	select BR2_PACKAGE_LIBCAMERA_HAS_PIPELINE
	help
	  Pipeline for i.MX8 SoC ISI capture interface.

config BR2_PACKAGE_LIBCAMERA_PIPELINE_IPU3
	bool "ipu3 pipeline"
	depends on BR2_i386 || BR2_x86_64
	select BR2_PACKAGE_LIBCAMERA_HAS_PIPELINE
	help
	  Pipeline for Intel IPU3.

config BR2_PACKAGE_LIBCAMERA_PIPELINE_RKISP1
	bool "rkisp1 pipeline"
	depends on BR2_arm || BR2_aarch64
	select BR2_PACKAGE_LIBCAMERA_HAS_PIPELINE
	help
	  Pipeline for Rockchip ISP1.

config BR2_PACKAGE_LIBCAMERA_PIPELINE_MALI_C55
	bool "mali-c55 pipeline"
	depends on BR2_arm || BR2_aarch64
	select BR2_PACKAGE_LIBCAMERA_HAS_PIPELINE
	help
	  Pipeline for Arm Mali-C55 ISP.

config BR2_PACKAGE_LIBCAMERA_PIPELINE_RPI_VC4
	bool "rpi/vc4 pipeline"
	depends on BR2_arm || BR2_aarch64
	select BR2_PACKAGE_LIBCAMERA_HAS_PIPELINE
	help
	  Pipeline for Raspberry Pi devices.

config BR2_PACKAGE_LIBCAMERA_PIPELINE_RPI_PISP
	bool "rpi/pisp pipeline"
	depends on BR2_arm || BR2_aarch64
	select BR2_PACKAGE_LIBCAMERA_HAS_PIPELINE
	select BR2_PACKAGE_LIBPISP
	select BR2_PACKAGE_LIBYUV
	select BR2_PACKAGE_BZIP2
	select BR2_PACKAGE_JPEG
	help
	  Pipeline for Raspberry Pi 5 (RP1/PiSP) devices.

config BR2_PACKAGE_LIBCAMERA_PIPELINE_SIMPLE
	bool "simple pipeline"
	select BR2_PACKAGE_LIBCAMERA_HAS_PIPELINE
	help
	  Pipeline for simple pipelines.

config BR2_PACKAGE_LIBCAMERA_PIPELINE_UVCVIDEO
	bool "uvcvideo pipeline"
	help
	  Pipeline for uvcvideo devices.

config BR2_PACKAGE_LIBCAMERA_PIPELINE_VIMC
	bool "vimc pipeline"
	select BR2_PACKAGE_LIBCAMERA_HAS_PIPELINE
	help
	  Pipeline for the vimc device.

config BR2_PACKAGE_LIBCAMERA_TRACING
	bool "lttng tracing"
	depends on BR2_USE_WCHAR # lttng-libust
	depends on BR2_PACKAGE_LIBURCU_ARCH_SUPPORTS # lttng-libust
	select BR2_PACKAGE_LTTNG_LIBUST
	help
	  Build libcamera with LTTng tracepoints. Links lttng-ust
	  (and liburcu, numactl) into every libcamera process.

config BR2_PACKAGE_LIBCAMERA_COMPLIANCE
	bool "lc-compliance test application"
	depends on BR2_USE_WCHAR # gtest
	depends on BR2_TOOLCHAIN_HAS_THREADS # gtest
	depends on BR2_INSTALL_LIBSTDCPP # gtest
	depends on BR2_TOOLCHAIN_GCC_AT_LEAST_5 # gtest
	depends on BR2_USE_MMU # gtest
	select BR2_PACKAGE_GTEST
	select BR2_PACKAGE_LIBEVENT
	help
	  lc-compliance test application

comment "lc-compliance test application needs a toolchain w/ C++, wchar, threads, gcc >= 5"
	depends on BR2_USE_MMU
	depends on !BR2_USE_WCHAR || !BR2_TOOLCHAIN_HAS_THREADS || \
		!BR2_INSTALL_LIBSTDCPP || !BR2_TOOLCHAIN_GCC_AT_LEAST_5

endif # BR2_PACKAGE_LIBCAMERA

comment "libcamera needs a toolchain w/ C++, threads, dynamic library, gcc >= 9"
	depends on BR2_PACKAGE_LIBCAMERA_ARCH_SUPPORTS
	depends on !BR2_INSTALL_LIBSTDCPP || !BR2_TOOLCHAIN_HAS_THREADS || \
		!BR2_TOOLCHAIN_GCC_AT_LEAST_9 || BR2_STATIC_LIBS
```

## raze/assets/buildroot/external/package/photonvision-jre/Config.in
```kconfig
config BR2_PACKAGE_PHOTONVISION_JRE
	bool "photonvision-jre"
	depends on BR2_aarch64
	depends on BR2_TOOLCHAIN_USES_GLIBC
	help
	  A minimal Java 25 runtime for PhotonVision, linked with jlink
	  from Eclipse Temurin's prebuilt aarch64 jmods (no OpenJDK
	  build), installed to /usr/lib/jvm with /usr/bin/java.

	  https://adoptium.net/

comment "photonvision-jre needs an aarch64 glibc toolchain"
	depends on !BR2_aarch64 || !BR2_TOOLCHAIN_USES_GLIBC
```
